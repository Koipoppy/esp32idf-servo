## sdkconfig.defaults
```kconfig
# ESP-IDF 默认配置

# 目标芯片为 ESP32-S3
CONFIG_IDF_TARGET="esp32s3"

# 启用日志
CONFIG_LOG_DEFAULT_LEVEL_INFO=y
CONFIG_LOG_DEFAULT_LEVEL=4

# 优化级别
CONFIG_OPTIMIZATION_PERF=y
```
